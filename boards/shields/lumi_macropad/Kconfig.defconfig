## boards/shields/lumi_macropad/Kconfig.defconfig
```kconfig
if SHIELD_LUMI_MACROPAD

config ZMK_KEYBOARD_NAME
    default "DIAL DESK"

endif
```

## dts/bindings/behaviors/zmk,behavior-lumi-action.yaml
```yaml
# SPDX-License-Identifier: MIT

description: Lumi companion action trigger
compatible: "zmk,behavior-lumi-action"
include: one_param.yaml
```

## dts/bindings/behaviors/zmk,behavior-lumi-rgb.yaml
```yaml
# SPDX-License-Identifier: MIT

description: Lumi RGB control action
compatible: "zmk,behavior-lumi-rgb"
include: one_param.yaml
```
